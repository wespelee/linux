## Documentation/devicetree/bindings/arm/bcm/raspberrypi,firmware.txt
```
Raspberry Pi VideoCore firmware driver

Required properties:

- compatible:		Should be "rasbperrypi,firmware"
- mboxes:		Single-entry list which specifies which mailbox
			  controller and channel is used.  See
			  Documentation/devicetree/bindings/mailbox/mailbox.txt
			  for the semantics of this property.

- #power-domain-cells:	Must be 1

Example:

firmware {
	compatible = "rasbperrypi,firmware";
	mboxes = <&mailbox 0>
	#power-domain-cells = <1>;
};
```

## Documentation/devicetree/bindings/arm/bcm2836.txt
```
Broadcom BCM2836 device tree bindings
-------------------------------------------

Raspberry Pi 2 Model B
Required root node properties:
compatible = "raspberrypi,2-model-b", "brcm,bcm2836";

Generic BCM2836 board
Required root node properties:
compatible = "brcm,bcm2836";
```

## Documentation/devicetree/bindings/clock/raspberrypi,bcm2835-firmware-clocks.txt
```
Raspberry Pi firmware clock provider.

The Raspberry Pi architecture doesn't provide direct access to the
CLOCKMAN peripheral from the ARM side, so Linux has to make requests
to the VPU firmware to program them.

This binding uses the common clock binding:
Documentation/devicetree/bindings/clock/clock-bindings.txt

Required properties:
- compatible:		Should be "raspberrypi,bcm2835-firmware-clocks"

- #clock-cells:		Shall have value <1>.  The permitted clock-specifier
			  values can be found in
			  include/dt-bindings/clk/raspberrypi.h.

- raspberrypi,firmware:	Phandle to the firmware driver node.

Example:

firmware_clocks: firmware-clocks {
	compatible = "raspberrypi,bcm2835-firmware-clocks";
	#clock-cells = <1>;
	raspberrypi,firmware = <&firmware>;
};
```

## Documentation/devicetree/bindings/gpu/brcm,bcm-vc4.txt
```
Broadcom VC4 GPU

The VC4 device present on the Raspberry Pi includes a display system
with HDMI output and the HVS scaler for compositing display planes.

Required properties for VC4:
- compatible:	Should be "brcm,vc4"
- crtcs:	List of phandles of pixelvalve scanout engines
- hvss:		List of phandles of HVS video scalers
- encoders:	List of phandles of output encoders (HDMI, SDTV)

Required properties for Pixel Valve:
- compatible:	Should be "brcm,vc4-pixelvalve"
- reg:		Physical base address and length of the PV's registers
- interrupts:	The interrupt number
		  See bindings/interrupt-controller/brcm,bcm2835-armctrl-ic.txt

Required properties for HVS:
- compatible:	Should be "brcm,vc4-hvs"
- reg:		Physical base address and length of the HVS's registers
- interrupts:	The interrupt number
		  See bindings/interrupt-controller/brcm,bcm2835-armctrl-ic.txt

Required properties for HDMI
- compatible:	Should be "brcm,vc4-hdmi"
- reg:		Physical base address and length of the two register ranges
		  ("HDMI" and "HD", in that order)
- interrupts:	The interrupt numbers
		  See bindings/interrupt-controller/brcm,bcm2835-armctrl-ic.txt
- ddc:		phandle of the I2C controller used for DDC EDID probing
- crtc:		phandle to the pixelvalve CRTC the HDMI encoder is attached to

Optional properties for HDMI:
- hpd-gpio:	The GPIO pin for HDMI hotplug detect (if it doesn't appear
		  as an interrupt/status bit in the HDMI controller
		  itself).  See bindings/pinctrl/brcm,bcm2835-gpio.txt

Example:
pv0: brcm,vc4-pixelvalve@7e206000 {
	compatible = "brcm,vc4-pixelvalve";
	reg = <0x7e206000 0x100>;
	interrupts = <2 13>; /* pwa2 */
};

pv1: brcm,vc4-pixelvalve@7e207000 {
	compatible = "brcm,vc4-pixelvalve";
	reg = <0x7e207000 0x100>;
	interrupts = <2 14>; /* pwa1 */
};

pv2: brcm,vc4-pixelvalve@7e807000 {
	compatible = "brcm,vc4-pixelvalve";
	reg = <0x7e807000 0x100>;
	interrupts = <2 10>; /* pixelvalve */
};

hvs: brcm,hvs@7e400000 {
	compatible = "brcm,vc4-hvs";
	reg = <0x7e400000 0x6000>;
	interrupts = <2 1>;
};

hdmi: brcm,vc4-hdmi@7e902000 {
	compatible = "brcm,vc4-hdmi";
	reg = <0x7e902000 0x600>,
	      <0x7e808000 0x100>;
	interrupts = <2 8>, <2 9>;
	ddc = <&i2c2>;
	hpd-gpio = <&gpio 46 GPIO_ACTIVE_HIGH>;
	crtc = <&pv2>;
};

vc4: vc4@0x7e4c0000 {
	compatible = "brcm,vc4";

	crtcs = <&pv0>, <&pv1>, <&pv2>;
	encoders = <&hdmi>;
	hvss = <&hvs>;
};
```

## Documentation/devicetree/bindings/mfd/brcm,bcm2836-arm-local.txt
```
* Device tree bindings for ARM local registers on BCM2836.

The ARM local registers control per-cpu IRQ masking, IPIs, and the
system timer clock on BCM2836.

Required properties:
- compatible:		"brcm,bcm2836-arm-local", "syscon"
- reg:			contains offset/length value of the MMIO region

Example:

syscon@40000000 {
       compatible = "brcm,bcm2836-arm-local", "syscon";
       reg = <0x40000000 0x100>;
};
```
